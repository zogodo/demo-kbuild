## Kconfig
```kconfig
# menu "CPU Config"
choice CPU_SELECT
    prompt "cpu config"
    default MANUAL

    config MANUAL
        bool "manual."
    config ONE_CORE
        bool "1 core"
        select SOCKET0
        select SOCKET0_CLUSTER0
        select SOCKET0_CLUSTER0_CORE0
    config TWO_CORE
        bool "2 core"
        select SOCKET0
        select SOCKET0_CLUSTER0
        select SOCKET0_CLUSTER0_CORE0
        select SOCKET0_CLUSTER0_CORE1
    config ALL_CORE
        bool "use all core"
        select SOCKET0
        select SOCKET0_CLUSTER0
        select SOCKET0_CLUSTER0_CORE0
        select SOCKET0_CLUSTER0_CORE1
        select SOCKET0_CLUSTER1
        select SOCKET0_CLUSTER1_CORE0
        select SOCKET0_CLUSTER1_CORE1
        select SOCKET1
        select SOCKET1_CLUSTER0
        select SOCKET1_CLUSTER0_CORE0
        select SOCKET1_CLUSTER0_CORE1
        select SOCKET1_CLUSTER1
        select SOCKET1_CLUSTER1_CORE0
        select SOCKET1_CLUSTER1_CORE1
endchoice

config SOCKET0
    bool "socket0"
    default y
config SOCKET0_CLUSTER0
    bool "socket0 cluster0"
    depends on SOCKET0
    default y
config SOCKET0_CLUSTER0_CORE0
    bool "socket0 cluster0 core0"
    depends on SOCKET0_CLUSTER0
    default y
config SOCKET0_CLUSTER0_CORE1
    bool "socket0 cluster0 core1"
    depends on SOCKET0_CLUSTER0
    default n
config SOCKET0_CLUSTER1
    bool "socket0 cluster1"
    depends on SOCKET0
    default y if TWO_CORE_DDR_REAL_AUTO_BACK_BOOT
config SOCKET0_CLUSTER1_CORE0
    bool "socket0 cluster1 core0"
    depends on SOCKET0_CLUSTER1
    default n
config SOCKET0_CLUSTER1_CORE1
    bool "socket0 cluster1 core1"
    depends on SOCKET0_CLUSTER1
    default n

config SOCKET1
    bool "socket1"
    default n
config SOCKET1_CLUSTER0
    bool "socket1 cluster0"
    depends on SOCKET1
    default n
config SOCKET1_CLUSTER0_CORE0
    bool "socket1 cluster0 core0"
    depends on SOCKET1_CLUSTER0
    default n
config SOCKET1_CLUSTER0_CORE1
    bool "socket1 cluster0 core1"
    depends on SOCKET1_CLUSTER0
    default n
config SOCKET1_CLUSTER1
    bool "socket1 cluster1"
    depends on SOCKET1
    default n
config SOCKET1_CLUSTER1_CORE0
    bool "socket1 cluster1 core0"
    depends on SOCKET1_CLUSTER1
    default n
config SOCKET1_CLUSTER1_CORE1
    bool "socket1 cluster1 core1"
    depends on SOCKET1_CLUSTER1
    default n
# endmenu

# menu "NET Config"
config SNF
    int "SNF"
    range 1 7
    default 1
config HNF
    int "HNF"
    range 1 7
    default 1
# endmenu

# menu "DDR Config"
choice DDR_TYPE
    prompt "DDR type"
    default DDR_TYPE_MODULE

    config DDR_TYPE_MODULE
        bool "module"
    config DDR_TYPE_REAL
        bool "real"
endchoice

config DDR_SIZE
    string "DDR size"
    depends on DDR_TYPE_REAL
    default "16GB"
config DDR_ECC
    bool "DDR ecc"
    depends on DDR_TYPE_REAL
    default n
config DDR_AES
    bool "DDR aes"
    depends on DDR_TYPE_REAL
    default n
config DDR_TZC
    bool "DDR tzc"
    depends on DDR_TYPE_REAL
    default n
# endmenu

# menu "PCIE Config"
choice PCIE_TYPE
    prompt "PCIE type"
    default PCIE_TYPE_MODULE

    config PCIE_TYPE_MODULE
        bool "module"
endchoice
# endmenu

choice BOOT_TYPE
    prompt "Boot type"
    default BOOT_TYPE_MANUAL

    config BOOT_TYPE_MANUAL
        bool "manual"
    config BOOT_TYPE_AUTO_FRONT_DOOR
        bool "auto front door"
    config BOOT_TYPE_AUTO_BACK_DOOR
        bool "auto back door"
endchoice

choice FILE_SYSTEM_TYPE
    prompt "File system type"
    default FILE_SYSTEM_TYPE_MINIMUM

    config FILE_SYSTEM_TYPE_MINIMUM
        bool "minimum"
    config FILE_SYSTEM_TYPE_STREAM
        bool "with stream"
    config FILE_SYSTEM_TYPE_FIO
        bool "with fio"
    config FILE_SYSTEM_TYPE_LAT_MEM_RD
        bool "with lat_mem_rd"
    config FILE_SYSTEM_TYPE_STREAM_FIO
        bool "with stream and fio"
endchoice
```
